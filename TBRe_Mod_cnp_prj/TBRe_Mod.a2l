/****************************************************
* ASAP2 file: TBRe_Mod.a2l
* Model file: TBRe_Mod.mdl
* MATLAB version: 9.3.0.713579 (R2017b)
****************************************************/ ASAP2_VERSION 1 60
/begin PROJECT TBRe_Mod "Simulink XCP Server ASAP2 project"
/begin HEADER "Header Comments go here" /end HEADER
/* Project modules: */
/begin MODULE TBRe_Mod "Simulink XCP Server ASAP2 module"
/* TBRe_Mod: ECU-specific management data */
/begin MOD_PAR "MOD PAR comment goes here" /end MOD_PAR
/* TBRe_Mod: format specification */
/* TBRe_Mod: protocol layer */
/begin IF_DATA XCP
 /begin PROTOCOL_LAYER /* XCP protocol layer ver. */ 0x0100 /* T1 [ms] */ 0x07D0 /* T2 [ms] */ 0x00C8 /* T3 [ms] */ 0 /* T4 [ms] */ 0 /* T5 [ms] */ 0 /* T6 [ms] */ 0 /* T7 [ms] */ 0 /* MAX_CTO */ 0xFF /* MAX_DTO */ 0x00FF BYTE_ORDER_MSB_LAST ADDRESS_GRANULARITY_BYTE /* Optional commands: */ OPTIONAL_CMD ALLOC_ODT_ENTRY OPTIONAL_CMD ALLOC_ODT OPTIONAL_CMD ALLOC_DAQ OPTIONAL_CMD FREE_DAQ OPTIONAL_CMD GET_DAQ_RESOLUTION_INFO OPTIONAL_CMD GET_DAQ_PROCESSOR_INFO OPTIONAL_CMD GET_DAQ_CLOCK OPTIONAL_CMD START_STOP_SYNCH OPTIONAL_CMD START_STOP_DAQ_LIST OPTIONAL_CMD GET_DAQ_LIST_MODE OPTIONAL_CMD SET_DAQ_LIST_MODE OPTIONAL_CMD WRITE_DAQ OPTIONAL_CMD SET_DAQ_PTR OPTIONAL_CMD CLEAR_DAQ_LIST OPTIONAL_CMD DOWNLOAD OPTIONAL_CMD SHORT_UPLOAD OPTIONAL_CMD UPLOAD OPTIONAL_CMD SET_MTA OPTIONAL_CMD GET_COMM_MODE_INFO /end PROTOCOL_LAYER
 /begin DAQ /* DAQ_CONFIG_TYPE */ DYNAMIC /* MAX_DAQ */ 0x0000 /* MAX_EVENT_CHANNEL */ 0x0004 /* MIN_DAQ */ 0x00 OPTIMISATION_TYPE_DEFAULT ADDRESS_EXTENSION_FREE IDENTIFICATION_FIELD_TYPE_ABSOLUTE GRANULARITY_ODT_ENTRY_SIZE_DAQ_BYTE /* MAX_ODT_ENTRY_SIZE_DAQ */ 0xFE NO_OVERLOAD_INDICATION PRESCALER_SUPPORTED
  /begin TIMESTAMP_SUPPORTED /* TIMESTAMP_TICKS */ 0x0001 SIZE_DWORD UNIT_10US TIMESTAMP_FIXED /end TIMESTAMP_SUPPORTED
  /* Events: */
  /begin EVENT "on TBRe_Mod calculated" "mdl_step" 0x0000 DAQ 0xFF 0x00 0x06 0x00 /end EVENT
  /begin EVENT "stim TBRe_Mod" "mdl_stim" 0x0001 STIM 0xFF 0x00 0x06 0x00 /end EVENT
  /begin EVENT "on 2nd TBRe_Mod step" "2ndstep" 0x0002 DAQ 0xFF 0x00 0x06 0x00 /end EVENT
  /begin EVENT "on 10th TBRe_Mod step" "10thstep" 0x0003 DAQ 0xFF 0x00 0x06 0x00 /end EVENT
  /begin EVENT "on 100th TBRe_Mod step" "100thstep" 0x0004 DAQ 0xFF 0x00 0x06 0x00 /end EVENT
 /end DAQ
 /begin XCP_ON_TCP_IP /* XCP on TCP_IP version */ 0x0100 /* PORT */ 5555 ADDRESS "localhost" /end XCP_ON_TCP_IP
/end IF_DATA
/* CANape configuration parameters: */
/begin IF_DATA CNP_CREATE_INI
 /begin TP_BLOB 0x0100 PARAMETER "canape.ini" "$CNP_DVC_SCTN$" "IGNORE_CTR_FAULTS" "1" /end TP_BLOB
/end IF_DATA
/begin IF_DATA CNP_CREATE_INI
 /begin TP_BLOB 0x0100 PARAMETER "canape.ini" "$CNP_DVC_SCTN$" "INIT_TIMEOUT" "10000" /end TP_BLOB
/end IF_DATA
/begin IF_DATA CNP_CREATE_INI
 /begin TP_BLOB 0x0100 PARAMETER "canape.ini" "$CNP_DVC_SCTN$" "ODT_ENTRY_ADDRESS_OPT_DISABLED" "1" /end TP_BLOB
/end IF_DATA
/begin IF_DATA CNP_CREATE_INI
 /begin TP_BLOB 0x0100 PARAMETER "canape.ini" "$CNP_DVC_SCTN$" "OVERRUN_HANDLING" "1" /end TP_BLOB
/end IF_DATA
/begin IF_DATA CNP_CREATE_INI
 /begin TP_BLOB 0x0100 PARAMETER "canape.ini" "$CNP_DVC_SCTN$" "POLLING_DISABLED" "1" /end TP_BLOB
/end IF_DATA
/begin IF_DATA CNP_CREATE_INI
 /begin TP_BLOB 0x0100 PARAMETER "canape.ini" "$CNP_DVC_SCTN$" "READBACK_DISABLED" "1" /end TP_BLOB
/end IF_DATA
/* Include additional ASAP2 database files here ... */
/* /include <filename> */
/* TBRe_Mod: conversion methods */
/begin COMPU_METHOD SL_COMPU_METHOD /* LongIdentifier */ "Q = V" /* ConversionType */ RAT_FUNC /* Format */ "%0.6f" /* Unit */ "" COEFFS 0 1 0 0 0 1 /end COMPU_METHOD
/* TBRe_Mod: record layouts */
/begin RECORD_LAYOUT Lookup2D_X_FLOAT32_IEEE AXIS_PTS_X 1 FLOAT32_IEEE INDEX_INCR DIRECT /end RECORD_LAYOUT
/begin RECORD_LAYOUT Lookup2D_X_FLOAT64_IEEE AXIS_PTS_X 1 FLOAT64_IEEE INDEX_INCR DIRECT /end RECORD_LAYOUT
/begin RECORD_LAYOUT Lookup2D_X_SBYTE_IEEE AXIS_PTS_X 1 SBYTE INDEX_INCR DIRECT /end RECORD_LAYOUT
/begin RECORD_LAYOUT Lookup2D_X_SLONG_IEEE AXIS_PTS_X 1 SLONG INDEX_INCR DIRECT /end RECORD_LAYOUT
/begin RECORD_LAYOUT Lookup2D_X_SWORD_IEEE AXIS_PTS_X 1 SWORD INDEX_INCR DIRECT /end RECORD_LAYOUT
/begin RECORD_LAYOUT Lookup2D_X_UBYTE_IEEE AXIS_PTS_X 1 UBYTE INDEX_INCR DIRECT /end RECORD_LAYOUT
/begin RECORD_LAYOUT Lookup2D_X_ULONG_IEEE AXIS_PTS_X 1 ULONG INDEX_INCR DIRECT /end RECORD_LAYOUT
/begin RECORD_LAYOUT Lookup2D_X_UWORD_IEEE AXIS_PTS_X 1 UWORD INDEX_INCR DIRECT /end RECORD_LAYOUT
/begin RECORD_LAYOUT Scalar_FLOAT64_IEEE FNC_VALUES 1 FLOAT64_IEEE COLUMN_DIR DIRECT /end RECORD_LAYOUT
/begin RECORD_LAYOUT __A_INT64_S FNC_VALUES 1 A_INT64 COLUMN_DIR DIRECT /end RECORD_LAYOUT
/begin RECORD_LAYOUT __A_UINT64_S FNC_VALUES 1 A_UINT64 COLUMN_DIR DIRECT /end RECORD_LAYOUT
/begin RECORD_LAYOUT __FLOAT32_IEEE_S FNC_VALUES 1 FLOAT32_IEEE COLUMN_DIR DIRECT /end RECORD_LAYOUT
/begin RECORD_LAYOUT __SBYTE_S FNC_VALUES 1 SBYTE COLUMN_DIR DIRECT /end RECORD_LAYOUT
/begin RECORD_LAYOUT __SLONG_S FNC_VALUES 1 SLONG COLUMN_DIR DIRECT /end RECORD_LAYOUT
/begin RECORD_LAYOUT __SWORD_S FNC_VALUES 1 SWORD COLUMN_DIR DIRECT /end RECORD_LAYOUT
/begin RECORD_LAYOUT __UBYTE_S FNC_VALUES 1 UBYTE COLUMN_DIR DIRECT /end RECORD_LAYOUT
/begin RECORD_LAYOUT __ULONG_S FNC_VALUES 1 ULONG COLUMN_DIR DIRECT /end RECORD_LAYOUT
/begin RECORD_LAYOUT __UWORD_S FNC_VALUES 1 UWORD COLUMN_DIR DIRECT /end RECORD_LAYOUT
/* TBRe_Mod: variable list */
/begin CHARACTERISTIC Brake_Active_Threshold "/Brake_Active_Threshold

TBRe_Mod/MainTask/Pre_Processing_Layer/Pedal_Box/Brake Bool Hysteresis/Brake_Active_Threshold" VALUE 0 __UBYTE_S 0.0 SL_COMPU_METHOD 0.000000 255.000000 /end CHARACTERISTIC
/begin CHARACTERISTIC Brk1_OOR_High "/Brk1_OOR_High

TBRe_Mod/MainTask/Pre_Processing_Layer/Pedal_Box/Brake Out Of Range Check/Compare To Constant/Brk1_OOR_High" VALUE 1 __UWORD_S 0.0 SL_COMPU_METHOD 0.000000 65535.000000 /end CHARACTERISTIC
/begin CHARACTERISTIC Brk1_OOR_Low "/Brk1_OOR_Low

TBRe_Mod/MainTask/Pre_Processing_Layer/Pedal_Box/Brake Out Of Range Check/Compare To Constant1/Brk1_OOR_Low" VALUE 3 __UWORD_S 0.0 SL_COMPU_METHOD 0.000000 65535.000000 /end CHARACTERISTIC
/begin CHARACTERISTIC Brk2_OOR_High "/Brk2_OOR_High

TBRe_Mod/MainTask/Pre_Processing_Layer/Pedal_Box/Brake Out Of Range Check/Compare To Constant2/Brk2_OOR_High" VALUE 5 __UWORD_S 0.0 SL_COMPU_METHOD 0.000000 65535.000000 /end CHARACTERISTIC
/begin CHARACTERISTIC Brk2_OOR_Low "/Brk2_OOR_Low

TBRe_Mod/MainTask/Pre_Processing_Layer/Pedal_Box/Brake Out Of Range Check/Compare To Constant3/Brk2_OOR_Low" VALUE 7 __UWORD_S 0.0 SL_COMPU_METHOD 0.000000 65535.000000 /end CHARACTERISTIC
/begin CHARACTERISTIC i "/i" VALUE 222 Scalar_FLOAT64_IEEE 0.0 SL_COMPU_METHOD -2147483648.000000 2147483647.000000 /end CHARACTERISTIC
/begin CHARACTERISTIC Motor_To_Road_Speed_Ratio "/Motor_To_Road_Speed_Ratio" VALUE 9 __FLOAT32_IEEE_S 0.0 SL_COMPU_METHOD -2147483648.000000 2147483647.000000 /end CHARACTERISTIC
/begin AXIS_PTS SOC_Calc_bPoint "/SOC_Calc_bPoint

TBRe_Mod/MainTask/Pre_Processing_Layer/LV_Battery/SOC_Calc/SOC_Calc_bPoint" 77 NO_INPUT_QUANTITY Lookup2D_X_FLOAT64_IEEE 0.0 SL_COMPU_METHOD 8 -2147483647.000000 2147483647.000000 /end AXIS_PTS
/begin CHARACTERISTIC SOC_Calc_Data "/SOC_Calc_Data

TBRe_Mod/MainTask/Pre_Processing_Layer/LV_Battery/SOC_Calc/SOC_Calc_Data" CURVE 13 Scalar_FLOAT64_IEEE 0.0 SL_COMPU_METHOD -2147483648.000000 2147483647.000000
 /begin AXIS_DESCR COM_AXIS NO_INPUT_QUANTITY SL_COMPU_METHOD 8 -2147483647.000000 2147483647.000000 AXIS_PTS_REF SOC_Calc_bPoint /end AXIS_DESCR
/end CHARACTERISTIC
/begin CHARACTERISTIC Throttle_Active_Threshold "/Throttle_Active_Threshold

TBRe_Mod/MainTask/Pre_Processing_Layer/Pedal_Box/Throttle Bool Hysteresis/Throttle_Active_Threshold" VALUE 141 __UBYTE_S 0.0 SL_COMPU_METHOD 0.000000 255.000000 /end CHARACTERISTIC
/begin AXIS_PTS Throttle_Torque_Map__240Nm_bPoint "/Throttle_Torque_Map__240Nm_bPoint

TBRe_Mod/MainTask/Vehicle_Functionality_Layer/Drive_Function/Throttle_Torque_Map_%_240Nm/Throttle_Torque_Map__240Nm_bPoint" 166 NO_INPUT_QUANTITY Lookup2D_X_FLOAT64_IEEE 0.0 SL_COMPU_METHOD 3 -2147483647.000000 2147483647.000000 /end AXIS_PTS
/begin CHARACTERISTIC Throttle_Torque_Map__240Nm_Data "/Throttle_Torque_Map__240Nm_Data

TBRe_Mod/MainTask/Vehicle_Functionality_Layer/Drive_Function/Throttle_Torque_Map_%_240Nm/Throttle_Torque_Map__240Nm_Data" CURVE 142 Scalar_FLOAT64_IEEE 0.0 SL_COMPU_METHOD -2147483648.000000 2147483647.000000
 /begin AXIS_DESCR COM_AXIS NO_INPUT_QUANTITY SL_COMPU_METHOD 3 -2147483647.000000 2147483647.000000 AXIS_PTS_REF Throttle_Torque_Map__240Nm_bPoint /end AXIS_DESCR
/end CHARACTERISTIC
/begin AXIS_PTS Voltage_Act_bPoint "/Voltage_Act_bPoint

TBRe_Mod/MainTask/Pre_Processing_Layer/LV_Battery/Voltage_Act/Voltage_Act_bPoint" 206 NO_INPUT_QUANTITY Lookup2D_X_FLOAT64_IEEE 0.0 SL_COMPU_METHOD 2 -2147483647.000000 2147483647.000000 /end AXIS_PTS
/begin CHARACTERISTIC Voltage_Act_Data "/Voltage_Act_Data

TBRe_Mod/MainTask/Pre_Processing_Layer/LV_Battery/Voltage_Act/Voltage_Act_Data" CURVE 190 Scalar_FLOAT64_IEEE 0.0 SL_COMPU_METHOD -2147483648.000000 2147483647.000000
 /begin AXIS_DESCR COM_AXIS NO_INPUT_QUANTITY SL_COMPU_METHOD 2 -2147483647.000000 2147483647.000000 AXIS_PTS_REF Voltage_Act_bPoint /end AXIS_DESCR
/end CHARACTERISTIC
/* TBRe_Mod: function list */
/begin FUNCTION MainTask "TBRe_Mod/MainTask"
 /begin SUB_FUNCTION MainTask.Pre_Processing_Layer MainTask.Vehicle_Functionality_Layer /end SUB_FUNCTION
/end FUNCTION
/begin FUNCTION MainTask.Pre_Processing_Layer "TBRe_Mod/MainTask/Pre_Processing_Layer"
 /begin SUB_FUNCTION MainTask.Pre_Processing_Layer.LV_Battery MainTask.Pre_Processing_Layer.Pedal_Box /end SUB_FUNCTION
/end FUNCTION
/begin FUNCTION MainTask.Pre_Processing_Layer.LV_Battery "TBRe_Mod/MainTask/Pre_Processing_Layer/LV_Battery"
 /begin SUB_FUNCTION MainTask.Pre_Processing_Layer.LV_Battery.SOC_Calc MainTask.Pre_Processing_Layer.LV_Battery.Voltage_Act /end SUB_FUNCTION
/end FUNCTION
/begin FUNCTION MainTask.Pre_Processing_Layer.LV_Battery.SOC_Calc "TBRe_Mod/MainTask/Pre_Processing_Layer/LV_Battery/SOC_Calc" /begin DEF_CHARACTERISTIC /end DEF_CHARACTERISTIC /begin REF_CHARACTERISTIC SOC_Calc_bPoint SOC_Calc_Data /end REF_CHARACTERISTIC /end FUNCTION
/begin FUNCTION MainTask.Pre_Processing_Layer.LV_Battery.Voltage_Act "TBRe_Mod/MainTask/Pre_Processing_Layer/LV_Battery/Voltage_Act" /begin DEF_CHARACTERISTIC /end DEF_CHARACTERISTIC /begin REF_CHARACTERISTIC Voltage_Act_bPoint Voltage_Act_Data /end REF_CHARACTERISTIC /end FUNCTION
/begin FUNCTION MainTask.Pre_Processing_Layer.Pedal_Box "TBRe_Mod/MainTask/Pre_Processing_Layer/Pedal_Box"
 /begin SUB_FUNCTION MainTask.Pre_Processing_Layer.Pedal_Box.Brake_Bool_Hysteresis MainTask.Pre_Processing_Layer.Pedal_Box.Brake_Out_Of_Range_Check MainTask.Pre_Processing_Layer.Pedal_Box.Throttle_Bool_Hysteresis /end SUB_FUNCTION
/end FUNCTION
/begin FUNCTION MainTask.Pre_Processing_Layer.Pedal_Box.Brake_Bool_Hysteresis "TBRe_Mod/MainTask/Pre_Processing_Layer/Pedal_Box/Brake Bool Hysteresis" /begin DEF_CHARACTERISTIC /end DEF_CHARACTERISTIC /begin REF_CHARACTERISTIC Brake_Active_Threshold /end REF_CHARACTERISTIC /end FUNCTION
/begin FUNCTION MainTask.Pre_Processing_Layer.Pedal_Box.Brake_Out_Of_Range_Check "TBRe_Mod/MainTask/Pre_Processing_Layer/Pedal_Box/Brake Out Of Range Check"
 /begin SUB_FUNCTION MainTask.Pre_Processing_Layer.Pedal_Box.Brake_Out_Of_Range_Check.Compare_To_Constant MainTask.Pre_Processing_Layer.Pedal_Box.Brake_Out_Of_Range_Check.Compare_To_Constant1 MainTask.Pre_Processing_Layer.Pedal_Box.Brake_Out_Of_Range_Check.Compare_To_Constant2 MainTask.Pre_Processing_Layer.Pedal_Box.Brake_Out_Of_Range_Check.Compare_To_Constant3 /end SUB_FUNCTION
/end FUNCTION
/begin FUNCTION MainTask.Pre_Processing_Layer.Pedal_Box.Brake_Out_Of_Range_Check.Compare_To_Constant "TBRe_Mod/MainTask/Pre_Processing_Layer/Pedal_Box/Brake Out Of Range Check/Compare To Constant" /begin DEF_CHARACTERISTIC /end DEF_CHARACTERISTIC /begin REF_CHARACTERISTIC Brk1_OOR_High /end REF_CHARACTERISTIC /end FUNCTION
/begin FUNCTION MainTask.Pre_Processing_Layer.Pedal_Box.Brake_Out_Of_Range_Check.Compare_To_Constant1 "TBRe_Mod/MainTask/Pre_Processing_Layer/Pedal_Box/Brake Out Of Range Check/Compare To Constant1" /begin DEF_CHARACTERISTIC /end DEF_CHARACTERISTIC /begin REF_CHARACTERISTIC Brk1_OOR_Low /end REF_CHARACTERISTIC /end FUNCTION
/begin FUNCTION MainTask.Pre_Processing_Layer.Pedal_Box.Brake_Out_Of_Range_Check.Compare_To_Constant2 "TBRe_Mod/MainTask/Pre_Processing_Layer/Pedal_Box/Brake Out Of Range Check/Compare To Constant2" /begin DEF_CHARACTERISTIC /end DEF_CHARACTERISTIC /begin REF_CHARACTERISTIC Brk2_OOR_High /end REF_CHARACTERISTIC /end FUNCTION
/begin FUNCTION MainTask.Pre_Processing_Layer.Pedal_Box.Brake_Out_Of_Range_Check.Compare_To_Constant3 "TBRe_Mod/MainTask/Pre_Processing_Layer/Pedal_Box/Brake Out Of Range Check/Compare To Constant3" /begin DEF_CHARACTERISTIC /end DEF_CHARACTERISTIC /begin REF_CHARACTERISTIC Brk2_OOR_Low /end REF_CHARACTERISTIC /end FUNCTION
/begin FUNCTION MainTask.Pre_Processing_Layer.Pedal_Box.Throttle_Bool_Hysteresis "TBRe_Mod/MainTask/Pre_Processing_Layer/Pedal_Box/Throttle Bool Hysteresis" /begin DEF_CHARACTERISTIC /end DEF_CHARACTERISTIC /begin REF_CHARACTERISTIC Throttle_Active_Threshold /end REF_CHARACTERISTIC /end FUNCTION
/begin FUNCTION MainTask.Vehicle_Functionality_Layer "TBRe_Mod/MainTask/Vehicle_Functionality_Layer" /begin SUB_FUNCTION MainTask.Vehicle_Functionality_Layer.Drive_Function /end SUB_FUNCTION /end FUNCTION
/begin FUNCTION MainTask.Vehicle_Functionality_Layer.Drive_Function "TBRe_Mod/MainTask/Vehicle_Functionality_Layer/Drive_Function"
 /begin SUB_FUNCTION MainTask.Vehicle_Functionality_Layer.Drive_Function.Throttle_Torque_Map___240Nm /end SUB_FUNCTION
/end FUNCTION
/begin FUNCTION MainTask.Vehicle_Functionality_Layer.Drive_Function.Throttle_Torque_Map___240Nm "TBRe_Mod/MainTask/Vehicle_Functionality_Layer/Drive_Function/Throttle_Torque_Map_%_240Nm" /begin DEF_CHARACTERISTIC /end DEF_CHARACTERISTIC
 /begin REF_CHARACTERISTIC Throttle_Torque_Map__240Nm_bPoint Throttle_Torque_Map__240Nm_Data /end REF_CHARACTERISTIC
/end FUNCTION
/* TBRe_Mod: group list */
/begin GROUP _[Base.Workspace] "<base>" ROOT
 /begin REF_CHARACTERISTIC Brake_Active_Threshold Brk1_OOR_High Brk1_OOR_Low Brk2_OOR_High Brk2_OOR_Low i Motor_To_Road_Speed_Ratio SOC_Calc_bPoint SOC_Calc_Data Throttle_Active_Threshold Throttle_Torque_Map__240Nm_bPoint Throttle_Torque_Map__240Nm_Data Voltage_Act_bPoint Voltage_Act_Data /end REF_CHARACTERISTIC
/end GROUP
/begin GROUP _[Model.Workspace] "<model>" ROOT /end GROUP
/end MODULE
/end PROJECT
/* Generated: 22-Apr-2022 12:21:59 */
/* EOF TBRe_Mod.a2l */
